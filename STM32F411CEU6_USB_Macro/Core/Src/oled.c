#include "oled.h"
#include "main.h"
#include <string.h>
#include <stddef.h>

static SPI_HandleTypeDef *s_hspi = NULL;
static uint8_t oled_buf[128 * 64 / 8];  // 1024 bytes

/* ====== 5x7 폰트 (ASCII 0x20~0x7F) ====== */
static const uint8_t font5x7[96][5] = {
  {0x00,0x00,0x00,0x00,0x00},{0x00,0x00,0x5F,0x00,0x00},{0x00,0x07,0x00,0x07,0x00},
  {0x14,0x7F,0x14,0x7F,0x14},{0x24,0x2A,0x7F,0x2A,0x12},{0x23,0x13,0x08,0x64,0x62},
  {0x36,0x49,0x55,0x22,0x50},{0x00,0x05,0x03,0x00,0x00},{0x00,0x1C,0x22,0x41,0x00},
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  {0x00,0x41,0x36,0x08,0x00},{0x08,0x08,0x2A,0x1C,0x08},{0x08,0x1C,0x2A,0x08,0x08},
};

static inline void OLED_DC_Cmd(void)   { HAL_GPIO_WritePin(DC_GPIO_Port,  DC_Pin,  GPIO_PIN_RESET); }
static inline void OLED_DC_Data(void)  { HAL_GPIO_WritePin(DC_GPIO_Port,  DC_Pin,  GPIO_PIN_SET);   }

static void OLED_SendCmd(uint8_t cmd)
{
  OLED_DC_Cmd();
  HAL_SPI_Transmit(s_hspi, &cmd, 1, HAL_MAX_DELAY);
}

static void OLED_SendCmdList(const uint8_t *cmds, size_t n)
{
  OLED_DC_Cmd();
  HAL_SPI_Transmit(s_hspi, (uint8_t*)cmds, (uint16_t)n, HAL_MAX_DELAY);
}

static void OLED_SendData(const uint8_t *data, size_t n)
{
  OLED_DC_Data();
  HAL_SPI_Transmit(s_hspi, (uint8_t*)data, (uint16_t)n, HAL_MAX_DELAY);
}

static void OLED_ResetPulse(void)
{
  HAL_GPIO_WritePin(RES_GPIO_Port, RES_Pin, GPIO_PIN_RESET);
  HAL_Delay(10);
  HAL_GPIO_WritePin(RES_GPIO_Port, RES_Pin, GPIO_PIN_SET);
  HAL_Delay(10);
}

/* ====== 공개 API ====== */

void OLED_Init(SPI_HandleTypeDef *hspi)
{
  s_hspi = hspi;

  // DC, RST 핀 초기화
  HAL_GPIO_WritePin(DC_GPIO_Port,  DC_Pin,  GPIO_PIN_RESET);
  HAL_GPIO_WritePin(RES_GPIO_Port, RES_Pin, GPIO_PIN_SET);
  HAL_Delay(50);

  OLED_ResetPulse();

  // SSD1306 초기화
  const uint8_t init1[] = {
    0xAE,         // Display OFF
    0xD5, 0x80,   // Set display clock divide
    0xA8, 0x3F,   // Set multiplex ratio
    0xD3, 0x00,   // Set display offset
    0x40,         // Set start line
    0x8D, 0x14,   // Charge pump
    0x20, 0x00,   // Horizontal addressing mode
    0xA1,         // Segment remap
    0xC8,         // COM scan direction
    0xDA, 0x12,   // COM pins config
    0x81, 0xCF,   // Set contrast
    0xD9, 0xF1,   // Set precharge
    0xDB, 0x40,   // Set VCOMH
    0xA4,         // Display all on resume
    0xA6,         // Normal display
    0xAF          // Display ON
  };
  OLED_SendCmdList(init1, sizeof(init1));

  OLED_Clear();
  OLED_Update();
}

void OLED_Clear(void)
{
  memset(oled_buf, 0x00, sizeof(oled_buf));
}

void OLED_Fill(uint8_t pattern)
{
  memset(oled_buf, pattern, sizeof(oled_buf));
}

void OLED_Update(void)
{
  // SSD1306: column/page addr 지정 후 1024바이트 연속 전송
  uint8_t cmd1[] = { 0x21, (uint8_t)(0 + OLED_COL_OFFSET), (uint8_t)(127 + OLED_COL_OFFSET) };
  uint8_t cmd2[] = { 0x22, 0x00, 0x07 };
  OLED_SendCmdList(cmd1, sizeof(cmd1));
  OLED_SendCmdList(cmd2, sizeof(cmd2));

  OLED_SendData(oled_buf, sizeof(oled_buf));
}

/* ====== 그리기 유틸(내부) ====== */

static void OLED_DrawChar(uint8_t row, uint8_t col_char, char c)
{
  if (row > 7) return;
  int x = (int)col_char * 6;
  if (x > 127 - 5) return;

  if (c < 0x20 || c > 0x7F) c = '?';
  const uint8_t *glyph = font5x7[(int)c - 0x20];

  int idx = (int)row * 128 + x;
  for (int i = 0; i < 5; i++) {
    oled_buf[idx + i] = glyph[i];
  }
  oled_buf[idx + 5] = 0x00;
}

void OLED_DrawStr(uint8_t row, uint8_t col_char, const char *s)
{
  while (*s) {
    OLED_DrawChar(row, col_char, *s++);
    col_char++;
    if (col_char >= 22) break;
  }
}

static void OLED_SetPixel(int x, int y, int on)
{
  if (x < 0 || x >= 128 || y < 0 || y >= 64) return;
  int idx = (y >> 3) * 128 + x;
  uint8_t mask = 1u << (y & 7);
  if (on) oled_buf[idx] |= mask;
  else    oled_buf[idx] &= (uint8_t)~mask;
}

static void OLED_DrawChar2x(int x, int y, char c)
{
  if (c < 0x20 || c > 0x7F) c = '?';
  const uint8_t *g = font5x7[(int)c - 0x20];

  for (int col = 0; col < 5; col++) {
    uint8_t bits = g[col];
    for (int row = 0; row < 7; row++) {
      if ((bits >> row) & 1) {
        OLED_SetPixel(x + col*2 + 0, y + row*2 + 0, 1);
        OLED_SetPixel(x + col*2 + 1, y + row*2 + 0, 1);
        OLED_SetPixel(x + col*2 + 0, y + row*2 + 1, 1);
        OLED_SetPixel(x + col*2 + 1, y + row*2 + 1, 1);
      }
    }
  }
}

void OLED_DrawStr2x(int x, int y, const char *s)
{
  while (*s) {
    OLED_DrawChar2x(x, y, *s++);
    x += 12;                 // 2배 글자 폭 + 간격
    if (x > 127 - 10) break;
  }
}
